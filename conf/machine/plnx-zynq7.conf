## conf/machine/plnx-zynq7.conf
```bitbake
require conf/machine/include/tune-zynq.inc
require conf/machine/include/machine-xilinx-overrides.inc
require conf/machine/include/machine-xilinx-default.inc
require conf/machine/include/machine-xilinx-board.inc

SERIAL_CONSOLES_CHECK = "${SERIAL_CONSOLES}"
MACHINE_FEATURES = "ext2 ext3 vfat usbhost"

# Add EXTRA_IMAGEDEPENDS default components
EXTRA_IMAGEDEPENDS_append_zynq = " virtual/fsbl"

UBOOT_MACHINE_forcevariable = "zynq_zybo_config"
HAS_PLATFORM_INIT_append += "zynq_zybo_config"
YAML_DT_BOARD_FLAGS_forcevariable = "{BOARD template}"
```
